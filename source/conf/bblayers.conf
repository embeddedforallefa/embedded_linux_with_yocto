## source/conf/bblayers.conf
```bitbake
# POKY_BBLAYERS_CONF_VERSION is increased each time build/conf/bblayers.conf
# changes incompatibly
POKY_BBLAYERS_CONF_VERSION = "2"

BBPATH = "${TOPDIR}"
BBFILES ?= ""

BBLAYERS ?= " \
  /home/veeresh/dev/yocto_iot/poky/meta \
  /home/veeresh/dev/yocto_iot/poky/meta-poky \
  /home/veeresh/dev/yocto_iot/poky/meta-yocto-bsp \
  /home/veeresh/dev/yocto_iot/poky/meta-iot-support-bbb \
  "
```

## source/yocto-layers/meta-iot-support-bbb/conf/layer.conf
```bitbake
# We have a conf and classes directory, add to BBPATH
BBPATH .= ":${LAYERDIR}"

# We have recipes-* directories, add to BBFILES
BBFILES += "${LAYERDIR}/recipes-*/*/*.bb \
            ${LAYERDIR}/recipes-*/*/*.bbappend"

BBFILE_COLLECTIONS += "meta-iot-support-bbb"
BBFILE_PATTERN_meta-iot-support-bbb = "^${LAYERDIR}/"
BBFILE_PRIORITY_meta-iot-support-bbb = "6"

LAYERDEPENDS_meta-iot-support-bbb = "core"
LAYERSERIES_COMPAT_meta-iot-support-bbb = "kirkstone"
```
